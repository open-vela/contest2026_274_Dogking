## app/a733home/Kconfig
```kconfig
config SYSTEM_A733HOME
	bool "A733 smart-home official GATT client acceptance"
	depends on BLUETOOTH_GATT_CLIENT && BLUETOOTH_FRAMEWORK_SOCKET_IPC && LIBUV
	default n
	help
		Read-only-device acceptance client: discovery, Read/Notify, PING and
		GET_STATE with application ACK. No physical output or automatic pairing.
```

## app/a733storage/Kconfig
```kconfig
# SPDX-License-Identifier: Apache-2.0
config SYSTEM_A733STORAGE
	bool "A733 bulk UFS file transfer and offline progress"
	depends on CRYPTO_MBEDTLS && FS_FAT && A733_UFS_DATA && SYSTEM_A733SERVICES
	default n
	help
	  Explicit background copy/SHA256 verification, exact compare and read
	  benchmark with 256KiB buffers. Serial status and cooperative stop work
	  without Wi-Fi. Never formats, deletes, overwrites or resets storage.
```

## board/a733-cubie-a7z/openvela-overlay/apps/netutils/ftpd/Kconfig
```kconfig
#
# For a description of the syntax of this configuration file,
# see the file kconfig-language.txt in the NuttX tools repository.
#

config NETUTILS_FTPD
	bool "FTP server"
	default n
	depends on NET_TCP
	---help---
		Enable support for the FTP server.

if NETUTILS_FTPD

config FTPD_DATABUFFERSIZE
	int "Transfer buffer bytes per client"
	default 4096
	range 512 65536

config FTPD_CMDBUFFERSIZE
	int "Command buffer bytes"
	default 512

config FTPD_MAX_SESSIONS
	int "Maximum concurrent clients"
	default 4
	range 1 16

config FTPD_IDLE_TIMEOUT
	int "Socket inactivity timeout (milliseconds)"
	default 60000
	range 1000 600000

config FTPD_PASSIVE_ONLY
	bool "Require passive data connections (prevent FTP bounce)"
	default y

config FTPD_KEEP_PARTIAL
	bool "Keep interrupted uploads for REST resume"
	default y

config FTPD_WORKERSTACKSIZE
	int "FTPD server thread stack size"
	default DEFAULT_TASK_STACKSIZE

config FTPD_LOGIN_PASSWD
	bool "Verify FTPD server login with encrypted password file"
	default n
	depends on FSUTILS_PASSWD
	---help---
		Use the content of an encrypted password file to verify user
		credentials.  This option requires that you have selected
		CONFIG_FSUTILS_PASSWD to enable the access methods of
		apps/fsutils/passwd.

endif
```

## board/a733-cubie-a7z/openvela-overlay/apps/system/a733camera/Kconfig
```kconfig
config SYSTEM_A733CAMERA
	tristate "A733 camera board inventory and CPU frame preparation"
	default n
	depends on ARCH_CHIP_A733
	help
	  'camera board' reads /dev/a733-camera if the passive checkpoint is
	  enabled. 'camera prepare' converts one explicit RGB24/NV12/RAW10
	  FILE frame to a new directory with 640x640 RGB24 and a ready marker.
	  No live sensor/video/CSI/ISP/DMA/NPU access or camera acceptance.

config A733_CAMERA_LIVE_TEST
	bool "Experimental bounded camera/YOLO/LVGL RAM live coordinator"
	default n
	depends on SYSTEM_A733CAMERA && A733_CAMERA_CONTROL_TEST
	depends on SYSTEM_A733DISPLAY && FS_TMPFS && BUILD_FLAT
	help
	  Flat-build only. Background task owns the camera and LVGL display.
	  Retains checked stop/cleanup on every frame; extends same-boot clean
	  capture budget to32768. Max3600seconds/session, cooperative stop.
	  Models and inference input use private pseudofs-root tmpfs; NOT an
	  MP4 recorder, continuous hardware stream or hardware soak acceptance.

config A733_CAMERA_PERF_TEST
	bool "v205 camera fast pixels, resident YOLO and gated sensor stream"
	default n
	depends on A733_CAMERA_LIVE_TEST && A733_NPU_TENSOR_IO
	help
	  Independent candidate. Preserves v4 ABI and legacy capture. Optional
	  per-fd immutable known-model snapshot; checked region retention and
	  phase timings; separate experimental sensor-on/gated-frame producer.
```

## board/a733-cubie-a7z/openvela-overlay/apps/system/a733display/Kconfig
```kconfig
config SYSTEM_A733DISPLAY
	tristate "Cubie A7Z LVGL display utility"
	default n
	depends on GRAPHICS_LVGL
	depends on LV_USE_NUTTX_LCD
	---help---
		Build the lightweight display command using official LVGL with the
		A733 direct ST7735 RGB565 flush path.  It provides hardware tests and
		the stable display-owner entry point for the AI pet UI without pulling
		in the complete LVGL demo asset collection.

if SYSTEM_A733DISPLAY

config A733DISPLAY_PROGNAME
	string "Program name"
	default "display"

config A733DISPLAY_PRIORITY
	int "Task priority"
	default 100

config A733DISPLAY_STACKSIZE
	int "Task stack size"
	default 32768

endif
```

## board/a733-cubie-a7z/openvela-overlay/apps/system/a733ftpd/Kconfig
```kconfig
config SYSTEM_A733FTPD
	tristate "A733 local file transfer service"
	depends on NET_IPv4 && !DISABLE_PTHREAD && !EXAMPLES_FTPD
	select NETUTILS_FTPD
	default n
```

## board/a733-cubie-a7z/openvela-overlay/apps/system/a733npu/Kconfig
```kconfig
config SYSTEM_A733NPU
	tristate "A733 VIP2 NPU inference command"
	default n
	depends on A733_NPU_CHECKPOINT
	---help---
		Build the 'npu' command.  It exposes the checked A7PM inference ABI,
		including atomic dynamic-input execution and YOLO detection results.

if SYSTEM_A733NPU

config A733NPU_PROGNAME
	string "Program name"
	default "npu"

config A733NPU_PRIORITY
	int "Task priority"
	default 100

config A733NPU_STACKSIZE
	int "Task stack size"
	default 8192

endif
```

## board/a733-cubie-a7z/openvela-overlay/apps/system/a733services/Kconfig
```kconfig
config SYSTEM_A733SERVICES
	bool "A733 persistent service startup management"
	depends on SYSTEM_A733WIFI && SYSTEM_A733FTPD && UTILS_SSH && CRYPTO_MBEDTLS
	default n
```

## board/a733-cubie-a7z/openvela-overlay/apps/system/a733wifi/Kconfig
```kconfig
config SYSTEM_A733WIFI
	tristate "A733 dual-band Wi-Fi manager"
	default n
	depends on A733_WIFI_USB_CHECKPOINT
	depends on WIRELESS_WAPI
	---help---
		Build the 'wifi' command for scanning and connecting the Cubie A7Z
		FCU760K module through openvela WAPI/WEXT.  The command keeps
			interactive secret input and board-local autoconnect policy while
			using the public wireless control API.

if SYSTEM_A733WIFI

config A733WIFI_PROGNAME
	string "Program name"
	default "wifi"

config A733WIFI_PRIORITY
	int "Task priority"
	default 100

config A733WIFI_STACKSIZE
	int "Task stack size"
	default 8192

endif
```

## board/a733-cubie-a7z/openvela-overlay/apps/system/aipetllm/Kconfig
```kconfig
config SYSTEM_AIPETLLM
	tristate "AI Pet local GGUF LLM runtime"
	default n
	depends on ARCH_ARM64
	---help---
		Build the custom Qwen2 GGUF CPU/NEON runtime and diagnostics.
		Supports bounded ChatML generation, RAM-resident models and SMP.
		This is not a complete llama.cpp port or a generic GGUF runtime.

if SYSTEM_AIPETLLM

config AIPETLLM_LLM_FRONTEND
	bool "Build the llm user command"
	default y
	depends on SYSTEM_AIPETLLM=y && !BUILD_KERNEL
	---help---
		Register a built-in llm command sharing the aipetllm runtime.
		Not supported as a separately loaded ELF application.

config AIPETLLM_PROGNAME
	string "Program name"
	default "aipetllm"

config AIPETLLM_PRIORITY
	int "Task priority"
	default 100

config AIPETLLM_STACKSIZE
	int "Task stack size"
	default 65536

config AIPETLLM_DEFAULT_MODEL
	string "Default GGUF model path"
	default "/data/models/qwen2.5-1.5b-instruct-q4_k_m.gguf"

endif
```

## board/a733-cubie-a7z/openvela-overlay/vendor/allwinnertech/boards/a733/cubie-a7z/Kconfig
```kconfig
#
# Radxa Cubie A7Z board configuration
#

if ARCH_BOARD_CUSTOM

config BOARD_A7Z_SD_UBOOT_HANDOFF
	bool
	default y
	---help---
		Boot through the official SD-card Boot0, SCP, BL31 and U-Boot chain.
		The firmware owns DDR/PMIC/clock initialization and transfers control
		to the ARM64 Image at 0x40200000.

config BOARD_A7Z_USER_LED
	bool "Cubie A7Z blue user LED"
	default y
	select DEV_GPIO
	depends on ARCH_BOARD_CUSTOM
	---help---
		Register the active-high PM2 blue user LED as /dev/userled.

config BOARD_A7Z_STORAGE
	bool "Cubie A7Z GPT and FAT data volume"
	default y
	depends on A733_SDMMC0
	select GPT_PARTITION
	select FS_FAT
	---help---
		Parse the SD-card GPT into stable A7Z partition nodes and mount only
		the dedicated FAT data partition at /data.  Firmware and boot
		partitions are never mounted automatically.

config BOARD_A7Z_ST7735
	bool "Cubie A7Z header ST7735 128x160 LCD"
	default n
	depends on ARCH_BOARD_CUSTOM
	select A733_HEADER_SPI
	select SPI_CMDDATA
	select LCD
	select LCD_DEV
	select LCD_ST7735
	---help---
		Enable the reusable board glue for a four-wire 1.8-inch ST7735
		display on SPI1.  D/C is PL5 (pin 22), reset is PB0 (pin 7),
		and the backlight is connected directly to 3.3 V.

endif
```
