## board/rockchip/boards/rk3506/luckfox-lyra-zero-w/configs/nsh/defconfig
```kconfig
#
# Initial single-core RK3506 bring-up configuration.
#

CONFIG_ALARM_ARCH=y
CONFIG_ARCH="arm"
CONFIG_ARCH_BOARD_CUSTOM=y
CONFIG_ARCH_BOARD_CUSTOM_DIR="../vendor/rockchip/boards/rk3506/luckfox-lyra-zero-w"
CONFIG_ARCH_BOARD_CUSTOM_DIR_RELPATH=y
CONFIG_ARCH_BOARD_CUSTOM_NAME="luckfox-lyra-zero-w"
CONFIG_ARCH_CHIP_ARM_CUSTOM=y
CONFIG_ARCH_CHIP_CUSTOM=y
CONFIG_ARCH_CHIP_CUSTOM_DIR="../vendor/rockchip/chips/rk3506"
CONFIG_ARCH_CHIP_CUSTOM_DIR_RELPATH=y
CONFIG_ARCH_CHIP_CUSTOM_NAME="rk3506"
CONFIG_ARCH_CHIP_RK3506=y
CONFIG_ARCH_INTERRUPTSTACK=2048
CONFIG_ARCH_LOWVECTORS=y
CONFIG_BOARD_LATE_INITIALIZE=y
CONFIG_BCH=y
CONFIG_BOOT_RUNFROMSDRAM=y
CONFIG_BUILTIN=y
CONFIG_CODECS_HASH_MD5=y
CONFIG_DEFAULT_TASK_STACKSIZE=4096
CONFIG_DEV_GPIO=y
CONFIG_DEV_NULL=y
CONFIG_DEV_ZERO=y
CONFIG_EXAMPLES_GPIO=y
CONFIG_EXAMPLES_HELLO=y
CONFIG_FAT_LFN=y
CONFIG_FAT_LFN_UTF8=y
CONFIG_FS_FAT=y
CONFIG_FS_PROCFS=y
CONFIG_FSUTILS_MKFATFS=y
CONFIG_GPT_PARTITION=y
CONFIG_IDLETHREAD_STACKSIZE=4096
CONFIG_I2C=y
CONFIG_I2C_DRIVER=y
CONFIG_INIT_ENTRYPOINT="nsh_main"
CONFIG_NSH_BUILTIN_APPS=y
CONFIG_NSH_FILEIOSIZE=512
CONFIG_NSH_LINELEN=128
CONFIG_NSH_MAXARGUMENTS=16
CONFIG_NSH_READLINE=y
CONFIG_PREALLOC_TIMERS=4
CONFIG_RAMLOG=y
CONFIG_RAMLOG_BUFSIZE=8192
CONFIG_RAMLOG_SYSLOG=y
CONFIG_RAM_SIZE=133169152
CONFIG_RAM_START=0x00100000
CONFIG_RAM_VSTART=0x00100000
CONFIG_RAW_BINARY=y
CONFIG_READLINE_CMD_HISTORY=y
CONFIG_RR_INTERVAL=200
CONFIG_MMCSD=y
CONFIG_MMCSD_MULTIBLOCK_LIMIT=128
CONFIG_MMCSD_SDIO=y
CONFIG_NETUTILS_CODECS=y
CONFIG_RK3506_SDMMC=y
CONFIG_RK3506_SDMMC_DMA=y
CONFIG_RK3506_I2C2=y
CONFIG_RK3506_SPI0=y
# CONFIG_RK3506_SPI0_LOOPBACK is not set
CONFIG_SCHED_HPWORK=y
CONFIG_SDIO_BLOCKSETUP=y
CONFIG_SYSTEM_NSH=y
CONFIG_SYSTEM_I2CTOOL=y
CONFIG_I2CTOOL_DEFFREQ=100000
CONFIG_SPI=y
CONFIG_SPI_EXCHANGE=y
CONFIG_SYSTEM_SPITOOL=y
CONFIG_SPITOOL_PROGNAME="spi"
CONFIG_SPITOOL_PRIORITY=100
CONFIG_SPITOOL_STACKSIZE=4096
CONFIG_SPITOOL_MINBUS=0
CONFIG_SPITOOL_MAXBUS=0
CONFIG_SPITOOL_DEFFREQ=1000000
CONFIG_SPITOOL_DEFMODE=0
CONFIG_SPITOOL_DEFWIDTH=8
CONFIG_SPITOOL_DEFWORDS=1
CONFIG_SPITOOL_DEFTRANS=1
CONFIG_SYSTEM_SYSTEM=y
CONFIG_SYSLOG_MAX_CHANNELS=2
CONFIG_SYSLOG_TIMESTAMP=y
CONFIG_16550_ADDRWIDTH=32
CONFIG_16550_REGINCR=1
CONFIG_16550_REGWIDTH=32
CONFIG_16550_SUPRESS_INITIAL_CONFIG=y
CONFIG_16550_UART=y
CONFIG_16550_UART0=y
CONFIG_16550_UART0_BASE=0xff0a0000
CONFIG_16550_UART0_BAUD=1500000
CONFIG_16550_UART0_BITS=8
CONFIG_16550_UART0_CLOCK=24000000
CONFIG_16550_UART0_IRQ=66
CONFIG_16550_UART0_SERIAL_CONSOLE=y
CONFIG_16550_WAIT_LCR=y
CONFIG_SERIAL_UART_ARCH_MMIO=y
CONFIG_USEC_PER_TICK=1000
# CONFIG_MMCSD_HAVE_CARDDETECT is not set
# CONFIG_MMCSD_HAVE_WRITEPROTECT is not set
# CONFIG_MMCSD_IOCSUPPORT is not set
# CONFIG_MMCSD_MMCSUPPORT is not set
# CONFIG_MMCSD_SPI is not set
```

## board/rockchip/boards/rk3506/luckfox-lyra-zero-w/tools/openvela.its
```
/*
 * Rockchip RK3506 U-Boot AMP/FIT image for single-core openvela bring-up.
 *
 * SPDX-License-Identifier: Apache-2.0
 */

/dts-v1/;

/ {
	description = "RK3506 openvela FIT image";
	#address-cells = <1>;

	images {
		amp0 {
			description = "openvela-cpu0";
			data = /incbin/("openvela.bin");
			type = "firmware";
			compression = "none";
			arch = "arm";
			os = "rtos";
			cpu = <0xf00>;
			thumb = <0>;
			hyp = <0>;
			load = <0x00100000>;
			entry = <0x00100000>;
			udelay = <10000>;

			hash {
				algo = "sha256";
			};
		};
	};

	configurations {
		default = "conf";

		conf {
			description = "RK3506 openvela on CPU0";
			loadables = "amp0";
		};
	};
};
```

## board/rockchip/boards/rv1103/luckfox-pico-mini/Kconfig
```kconfig
#
# Luckfox Pico Mini board configuration
#

if ARCH_BOARD_CUSTOM

config BOARD_RV1103_UBOOT_HANDOFF
	bool
	default y
	---help---
		The board is entered through the Rockchip SPI-NAND U-Boot FIT
		loader.  The BootROM, idblock and U-Boot initialize DDR, clocks,
		pin multiplexing and UART2 before openvela starts.

endif
```

## board/rockchip/boards/rv1103/luckfox-pico-mini/configs/nsh/defconfig
```kconfig
#
# Initial RV1103 / Luckfox Pico Mini SPI-NAND bring-up configuration.
#

CONFIG_ALARM_ARCH=y
CONFIG_ANALOG=y
CONFIG_ARCH="arm"
CONFIG_ARCH_BOARD_CUSTOM=y
CONFIG_ARCH_BOARD_CUSTOM_DIR="../vendor/rockchip/boards/rv1103/luckfox-pico-mini"
CONFIG_ARCH_BOARD_CUSTOM_DIR_RELPATH=y
CONFIG_ARCH_BOARD_CUSTOM_NAME="luckfox-pico-mini"
CONFIG_ARCH_CHIP_ARM_CUSTOM=y
CONFIG_ARCH_CHIP_CUSTOM=y
CONFIG_ARCH_CHIP_CUSTOM_DIR="../vendor/rockchip/chips/rv1103"
CONFIG_ARCH_CHIP_CUSTOM_DIR_RELPATH=y
CONFIG_ARCH_CHIP_CUSTOM_NAME="rv1103"
CONFIG_ARCH_CHIP_RV1103=y
CONFIG_ARCH_INTERRUPTSTACK=2048
CONFIG_ARCH_LOWVECTORS=y
CONFIG_ADC=y
CONFIG_BOARD_LATE_INITIALIZE=y
CONFIG_BOOT_RUNFROMSDRAM=y
CONFIG_BUILTIN=y
CONFIG_DEFAULT_TASK_STACKSIZE=4096
CONFIG_DEV_GPIO=y
CONFIG_DEV_NULL=y
CONFIG_DEV_RANDOM=y
CONFIG_DEV_URANDOM=y
CONFIG_DEV_URANDOM_ARCH=y
CONFIG_DEV_ZERO=y
CONFIG_EXAMPLES_ADC=y
CONFIG_EXAMPLES_ADC_SWTRIG=y
CONFIG_EXAMPLES_GPIO=y
CONFIG_EXAMPLES_HELLO=y
CONFIG_EXAMPLES_RANDOM=y
CONFIG_EXAMPLES_PWM=y
CONFIG_EXAMPLES_WATCHDOG=y
CONFIG_FS_PROCFS=y
CONFIG_I2C=y
CONFIG_I2C_DRIVER=y
CONFIG_INPUT=y
CONFIG_INPUT_BUTTONS=y
CONFIG_FS_LITTLEFS=y
CONFIG_FS_LITTLEFS_PROGRAM_SIZE_FACTOR=1
CONFIG_FS_LITTLEFS_READ_SIZE_FACTOR=1
CONFIG_FS_LITTLEFS_CACHE_SIZE_FACTOR=1
CONFIG_IDLETHREAD_STACKSIZE=4096
CONFIG_INIT_ENTRYPOINT="nsh_main"
CONFIG_NSH_BUILTIN_APPS=y
CONFIG_NSH_LINELEN=128
CONFIG_NSH_MAXARGUMENTS=16
CONFIG_NSH_READLINE=y
CONFIG_PREALLOC_TIMERS=4
CONFIG_RAMLOG=y
CONFIG_RAMLOG_BUFSIZE=8192
CONFIG_RAMLOG_SYSLOG=y
CONFIG_RAM_SIZE=41943040
CONFIG_RAM_START=0x00800000
CONFIG_RAM_VSTART=0x00800000
CONFIG_RAW_BINARY=y
CONFIG_READLINE_CMD_HISTORY=y
CONFIG_RR_INTERVAL=200
CONFIG_SCHED_HPWORK=y
CONFIG_RV1103_WATCHDOG=y
CONFIG_RV1103_TSADC=y
CONFIG_RV1103_TRNG=y
CONFIG_RV1103_PL330_DMA=y
CONFIG_RV1103_SFC_NAND=y
CONFIG_RV1103_SDMMC=y
CONFIG_RV1103_SDMMC_DMA=y
CONFIG_RV1103_USB_DWC3_CHECKPOINT=y
# CONFIG_RV1103_USB_CDCACM is not set
CONFIG_RV1103_I2C=y
CONFIG_RV1103_SC3336_CHECKPOINT=y
CONFIG_DRIVERS_VIDEO=y
CONFIG_VIDEO_STREAM=y
CONFIG_RV1103_SPI=y
CONFIG_RV1103_SPI0=y
CONFIG_RV1103_PWM=y
CONFIG_RV1103_PWM_CHANNEL=1
CONFIG_RV1103_PWM_ROUTE=0
CONFIG_RV1103_SARADC=y
CONFIG_RV1103_ADC_KEYS=y
CONFIG_RV1103_UART3_M1=y
CONFIG_RV1103_UART4_M1=y
CONFIG_BCH=y
CONFIG_MMCSD=y
CONFIG_MMCSD_SDIO=y
CONFIG_MMCSD_HAVE_CARDDETECT=y
CONFIG_MMCSD_MULTIBLOCK_LIMIT=128
# CONFIG_MMCSD_SPI is not set
# CONFIG_MMCSD_IOCSUPPORT is not set
# CONFIG_MMCSD_MMCSUPPORT is not set
# CONFIG_MMCSD_HAVE_WRITEPROTECT is not set
CONFIG_SDIO_BLOCKSETUP=y
CONFIG_SENSORS=y
CONFIG_SYSTEM_SENSORTEST=y
CONFIG_SYSTEM_NSH=y
CONFIG_SYSTEM_I2CTOOL=y
CONFIG_I2CTOOL_MINBUS=3
CONFIG_I2CTOOL_MAXBUS=4
CONFIG_SYSTEM_SPITOOL=y
CONFIG_SPITOOL_MINBUS=0
CONFIG_SPITOOL_MAXBUS=0
CONFIG_SYSTEM_SYSTEM=y
CONFIG_SYSLOG_MAX_CHANNELS=2
CONFIG_SYSLOG_TIMESTAMP=y
CONFIG_16550_ADDRWIDTH=32
CONFIG_16550_REGINCR=1
CONFIG_16550_REGWIDTH=32
CONFIG_16550_SUPRESS_INITIAL_CONFIG=y
CONFIG_16550_UART=y
CONFIG_16550_UART0=y
CONFIG_16550_UART0_BASE=0xff4c0000
CONFIG_16550_UART0_BAUD=115200
CONFIG_16550_UART0_BITS=8
CONFIG_16550_UART0_CLOCK=24000000
CONFIG_16550_UART0_IRQ=59
CONFIG_16550_UART0_SERIAL_CONSOLE=y
CONFIG_16550_UART1=y
CONFIG_16550_UART1_BASE=0xff4d0000
CONFIG_16550_UART1_BAUD=115200
CONFIG_16550_UART1_BITS=8
CONFIG_16550_UART1_CLOCK=24000000
CONFIG_16550_UART1_IRQ=60
CONFIG_16550_UART2=y
CONFIG_16550_UART2_BASE=0xff4e0000
CONFIG_16550_UART2_BAUD=115200
CONFIG_16550_UART2_BITS=8
CONFIG_16550_UART2_CLOCK=24000000
CONFIG_16550_UART2_IRQ=61
CONFIG_16550_WAIT_LCR=y
CONFIG_PWM=y
CONFIG_SPI=y
CONFIG_SPI_EXCHANGE=y
CONFIG_SPI_DRIVER=y
CONFIG_SERIAL_UART_ARCH_MMIO=y
CONFIG_USEC_PER_TICK=1000
```

## board/rockchip/boards/rv1103/luckfox-pico-mini/tools/openvela-spinand.its
```
/* SPDX-License-Identifier: Apache-2.0 */

/dts-v1/;
/ {
  description = "openvela for Luckfox Pico Mini SPI NAND";
  #address-cells = <1>;

  images {
    fdt {
      data = /incbin/("board.dtb");
      type = "flat_dt";
      arch = "arm";
      compression = "none";
      load = <0xffffff00>;
      hash {
        algo = "sha256";
      };
    };

    kernel {
      description = "openvela-rv1103";
      data = /incbin/("openvela.bin");
      type = "kernel";
      arch = "arm";
      os = "linux";
      compression = "none";
      load = <0x00800000>;
      entry = <0x00800000>;
      hash {
        algo = "sha256";
      };
    };

    resource {
      data = /incbin/("resource.img");
      type = "multi";
      arch = "arm";
      compression = "none";
      hash {
        algo = "sha256";
      };
    };
  };

  configurations {
    default = "conf";
    conf {
      description = "Boot openvela with the official RV1103 device tree";
      rollback-index = <0x00>;
      fdt = "fdt";
      kernel = "kernel";
      multi = "resource";
      signature {
        algo = "sha256,rsa2048";
        padding = "pss";
        key-name-hint = "dev";
        sign-images = "fdt", "kernel", "multi";
      };
    };
  };
};
```

## board/rockchip/chips/rk3506/Kconfig
```kconfig
#
# Rockchip RK3506 chip configuration
#

if ARCH_CHIP_CUSTOM

config ARCH_CHIP_RK3506
	bool "Rockchip RK3506"
	select LIBC_ATOMIC_IRQ if !SMP
	default y
	select ARCH_CORTEXA7
	select ARCH_HAVE_LOWVECTORS
	select ARCH_HAVE_SDIO
	select ARM_HAVE_NEON
	select ARMV7A_HAVE_GICv2
	select ARMV7A_HAVE_PTM
	---help---
		Support the Cortex-A7 application cores in the Rockchip RK3506.
		The initial port is uniprocessor and is entered from Rockchip
		U-Boot after DDR and clocks have been initialized.

endif

if ARCH_CHIP_RK3506

config RK3506_I2C2
	bool "RK3506 I2C2 controller"
	depends on I2C
	default n
	---help---
		Enable the RK3506 I2C2 master controller.  The Luckfox Lyra Zero W
		board routes it through RMIO to GPIO0_A0 (SDA) and GPIO0_A1 (SCL).
		The initial implementation uses bounded polling at 100/400 kHz.

config RK3506_SPI0
	bool "RK3506 SPI0 controller"
	depends on SPI
	default n
	---help---
		Enable the RK3506 SPI0 polling master on the fixed M0 pin group:
		GPIO0_C0 clock, C1 MOSI, C2 MISO and C3 chip-select zero.

config RK3506_SPI0_LOOPBACK
	bool "RK3506 SPI0 internal loopback test mode"
	depends on RK3506_SPI0
	default n
	---help---
		Route SPI0 transmit data back to its receiver internally.  This is a
		bring-up diagnostic and must be disabled before attaching peripherals.

config RK3506_AIC8800DC_PROBE
	bool "Luckfox AIC8800DC USB hardware probe"
	default n
	---help---
		Enable the first Wi-Fi bring-up checkpoint for the USB-connected
		AIC8800DC on Luckfox Lyra W boards.  It powers the module from
		GPIO1_C5, enables the RK3506 USB2 PHY and OTG1 clocks, verifies the
		DWC2 core ID and reports the PHY line state.  This option does not
		yet provide a network interface.

config RK3506_AIC8800DC_ENUM_PROBE
	bool "Enumerate the AIC8800DC over DWC2 control endpoint"
	default n
	depends on RK3506_AIC8800DC_PROBE
	---help---
		Initialize USB2 OTG1 as a polling DWC2 host, reset the onboard
		port, and read the AIC8800DC USB device descriptor.  This is an
		isolated bring-up checkpoint before the generic USB host and Wi-Fi
		drivers are enabled.

config RK3506_SDMMC
	bool "RK3506 DesignWare SDMMC controller"
	depends on MMCSD_SDIO
	default n
	---help---
		Enable the RK3506 DesignWare mobile-storage controller lower half.
		The controller always provides an interrupt-driven PIO path.

config RK3506_SDMMC_DMA
	bool "RK3506 SDMMC internal DMA (IDMAC)"
	depends on RK3506_SDMMC
	select SDIO_DMA
	default n
	---help---
		Enable the DesignWare internal DMA engine for normal SD-sector
		transfers in either 1-bit or 4-bit bus mode.  Short protocol payloads
		and reset-failed requests automatically use the PIO path.
		Cache-line-unaligned requests use an aligned internal bounce buffer.

endif
```
