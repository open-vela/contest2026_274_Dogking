## board/a733-cubie-a7z/openvela-overlay/vendor/allwinnertech/chips/a733/Kconfig
```kconfig
#
# Allwinner A733 chip configuration
#

if ARCH_CHIP_CUSTOM

config ARCH_CHIP_A733
	bool "Allwinner A733 (sun60iw2p1)"
	default y
	select ARCH_CPU_UNKNOWN
	select ARCH_HAVE_IRQTRIGGER
	select ARCH_HAVE_IRQPRIO
	select ARCH_HAVE_MULTICPU
	select ARCH_HAVE_RESET
	select ARCH_HAVE_POWEROFF
	select ARM64_HAVE_PSCI
	---help---
		Initial ARM64 application-core port for the Allwinner A733.  Boot0,
		SCP, BL31 and U-Boot remain responsible for DDR, clock and PMIC
		initialization.  CPU affinity is encoded in MPIDR Aff1: logical CPUs
		0..5 are Cortex-A55 and 6..7 are Cortex-A76.  The port uses the
		standard ARMv8 virtual timer, PSCI and GICv3 support.

# The openvela Zblue port uses Zephyr's 64BIT symbol, whose architecture
# Kconfig is not sourced by the NuttX integration. Match the A733 ABI so
# stack alignment and pointer-bearing buffer defaults are not 32-bit.
config 64BIT
	bool
	default y if ARCH_CHIP_A733

config A733_BOOT_DIAGNOSTICS
	bool "A733 early boot and constructor progress diagnostics"
	default n
	depends on ARCH_CHIP_A733
	---help---
		Diagnostic candidate only. Print CPU0 SMP launch/return and C++
		constructor addresses without stdio/allocation. Suppress only the
		concurrent secondary assembly banners, not exception diagnostics.
		The v188 voice build additionally uses BOARD_LATE_INITIALIZE and
		a 256 KiB AppBringUp stack so constructors need not run on idle.

config A733_WATCHDOG
	bool "A733 watchdog"
	default y
	select WATCHDOG
	depends on ARCH_CHIP_A733
	---help---
		Expose the sun60iw2p1 watchdog-v103 as /dev/watchdog0.  Merely
		opening the device does not start the reset timer.

config A733_TSADC
	bool "A733 thermal sensor"
	default y
	select SENSORS
	depends on ARCH_CHIP_A733
	---help---
		Expose the A733 CPU-little thermal channel through the openvela
		sensor framework as /dev/uorb/sensor_temp0.

config A733_HARDWARE_DIAG
	bool "A733 non-destructive hardware diagnostics"
	default y
	depends on ARCH_CHIP_A733
	---help---
		Register /dev/a733-hw.  Reading it snapshots the SDMMC, TWI, SPI,
		PWM, onboard wireless USB and UFS controller state without resetting
		a bus.  Cubie A7Z has no onboard Ethernet PHY or RJ45 connector.

config A733_TRNG
	bool "A733 Crypto Engine true-random generator"
	default y
	depends on ARCH_CHIP_A733
	---help---
		Enable the official sun60iw2 Crypto Engine v5 TRNG path and expose
		/dev/random plus /dev/urandom.  Startup and continuous-output tests
		must pass before either node is registered; TLS and SSH use this as
		their cryptographically secure entropy source.

config A733_NPU_TENSOR_IO
	bool "Experimental A733 checked multi-tensor NPU transport"
	default n
	depends on A733_NPU_CHECKPOINT
	---help---
		Add separately versioned A7TV query/run ioctls with up to 64 native
		input/output slices, full RAM buffer transfer and bounded execution.
		Uses existing MMU/pools, no boot inference, no generic NBG loader.
		Weights reload per call; not a realtime performance implementation.
		Hardware faults quarantine the backend until reboot. Keep disabled
		in the passed baseline until new prepared artifacts are board-tested.

config A733_NPU_GENERAL_ASR
	bool "Experimental general ASR larger bounded memory profile"
	default n
	depends on A733_NPU_TENSOR_IO
	---help---
		Reserve an 80 MiB low32 guarded DMA arena instead of 32 MiB, with
		8 MiB tensor I/O and a 64 MiB shared prepared workspace. This is
		for the separately qualified 6254-class general streaming ASR,
		not the old keyword encoder. Full image linking must still satisfy
		the existing 0x48000000 stage-1 boundary. No inference at boot.
		CPU-only immutable resident snapshots are bounded to 96 MiB.
		Keep disabled in the passed baseline until new image board tests.

config A733_CPU_ACOUSTIC
	bool "Experimental real CPU Matcha and NPU vocoder voice candidate"
	default n
	depends on A733_NPU_GENERAL_ASR && BUILD_FLAT
	depends on LIBCXX && CXX_MINI_LOCALIZATION && CXX_WCHAR
	depends on !CXX_EXCEPTION && !CXX_RTTI
	---help---
		Requires separately built, hash-verified NuttX/AArch64 static ORT
		libraries via A733_ORT_STATIC_PREFIX. Never use Linux .so files.
		Provides explicit RAM-only installation, not boot-time recording,
		hardware acceptance or a 3-4 second latency guarantee. Retain the
		passed image; Baker models carry separate noncommercial terms.

config A733_PRODUCT_V1
	bool "Integrated desktop pet v1.0 candidate"
	default n
	depends on A733_CPU_ACOUSTIC && A733_CAMERA_LIVE_TEST
	depends on EXAMPLES_AI_AGENT_VELA && SYSTEM_A733CAMERA && SYSTEM_A733DISPLAY
	---help---
		Explicitly started cloud/local voice routing, fresh YOLO descriptions
		and guarded UART4 STM32 control. Not a board acceptance claim.
		No boot-time recording, automatic motion authorization or NPU reset.

config A733_PRODUCT_V12
	bool "Desktop pet v1.2 low-latency PREVIEW (not stable v1.1)"
	default n
	depends on A733_PRODUCT_V1
	---help---
		Separate, default-off history settings and reusable CPU prefill
		workspace. Keeps persona, exact-prefix KV, complete replies and
		all NPU ownership/validation rules. No board latency guarantee.

config A733_NPU_CHECKPOINT
	bool "A733 VIP2 NPU hardware checkpoint"
	default y
	depends on ARCH_CHIP_A733
	---help---
		Power the sun60iw2 VIP2 NPU domain, select the official safe 600 MHz
		operating point, release its resets and expose identity/state through
		/dev/a733-npu.  Manual bounded controls exercise direct and translated
		VIP2 command fetches; boot never submits an NPU workload.  Register the
		first-stage /dev/npu0 runtime with per-open contexts, driver-owned low32
		buffers, cache control, translated submit/sync/cancel/reset and a manual
		deterministic hardware self-test.

config A733_WIFI_USB_CHECKPOINT
	bool "Cubie A7Z onboard FCU760K USB checkpoint"
	default y
	depends on ARCH_CHIP_A733
	---help---
		Power the onboard FCU760K Wi-Fi 6 / Bluetooth 5.4 module through
		PM0 and PM1, initialize its dedicated USB1 PHY/EHCI root port, and
		register /dev/a733-wifi with non-destructive checkpoint details.
		The implementation loads the official D80-U02 firmware, validates
		the runtime composite endpoint ownership and exercises the full-MAC
		message channel with MM_VERSION_REQ before higher network binding.

config A733_USB_CAMERA
	bool "Cubie A7Z external USB0 UVC camera checkpoint"
	default y
	depends on ARCH_CHIP_A733
	---help---
		Initialize the external USB2 OTG connector in high-speed host mode,
		enumerate a connected USB Video Class camera and expose descriptor,
		format, frame and streaming-endpoint diagnostics through
		/dev/a733-uvc.  Frame streaming remains disabled until the selected
		camera endpoint has been validated on real hardware.

config A733_SDMMC0
	bool "A733 SMHC0 SD-card controller"
	default y
	select ARCH_HAVE_SDIO
	select MMCSD
	select MMCSD_SDIO
	select SDIO_BLOCKSETUP
	depends on ARCH_CHIP_A733
	---help---
		Register the Cubie A7Z microSD slot through the standard NuttX
		SDIO/MMCSD stack.  The first implementation is conservative 4-bit
		PIO at 400 kHz identification and 12 MHz transfer clocks.

config A733_UFS_READONLY
	bool "Experimental A733 UFS read-only inherited-link transport"
	default n
	depends on ARCH_CHIP_A733 && !DISABLE_MOUNTPOINT
	---help---
		Register /dev/a733-ufs without any boot-time hardware access.
		Manual board collects only fixed CCU/RTC register snapshots. HCI
		probe/attach-ro are blocked until a real board power/domain provider
		is qualified; clock bits alone cannot authorize HCI MMIO. attach-ro=N
		requires an already powered, active, initialized, idle firmware link;
		cold-start board power/clock/reset adapter is not implemented. The
		separate M-PHY/UIC link core has no shell entry and is not connected
		to attach-ro. It cannot bypass the unverified board prerequisites.
		Publishes /dev/ufs0
		only after real NOP, INQUIRY and READ CAPACITY(16) complete. Read-only,
		bounded 64 KiB DMA, no reset/retry/format/erase/write or automount.
		Timeouts quarantine the engine and retain DMA memory until reboot.
		Keep disabled in the passed baseline until hardware validated.

config A733_UFS_HANDOFF_PROBE
	bool "Experimental manual UFS firmware-handoff HCI observation"
	default n
	depends on A733_UFS_READONLY
	---help---
		Allow only the explicit handoff command on the empirically observed
		A7Z CCU/RTC profile. This assumes successful UFS enumeration by the
		current boot firmware and retained power until manual execution.
		It reads HCI registers only; no writes, DMA, SCSI, PMIC or reset.
		Not a generic power provider and never authorizes attach-ro. A bus
		read itself cannot be rescued by a software timeout. Keep disabled
		outside the controlled board-test candidate.

config A733_UFS_QUIESCE
	bool "Experimental manual stop of empty inherited UFS queues"
	default n
	depends on A733_UFS_HANDOFF_PROBE
	---help---
		Explicit quiesce command only; never executed during boot. Requires
		the v167 observed active firmware/controller profile and no pending
		requests. Only writes zero to IE, UTRLRSR and UTMRLRSR, with readback,
		deadlines and a poll bound. Keeps firmware bases, never clears IS or
		doorbells and never resets/restarts. One attempt per boot; a failure
		after a write quarantines it. Does NOT qualify DMA or unlock attach.
		Retained firmware power and no other producer remain assumptions.

config A733_UFS_DMA_NOP
	bool "Experimental one-shot private-buffer UFS NOP DMA trial"
	default n
	depends on A733_UFS_QUIESCE
	---help---
		Manual dma-nop requires successful quiesce in this boot and a fresh
		stopped-controller snapshot. Uses dedicated static low32 guarded RAM,
		checks EL1 R/W translations, cleans/invalidates caches, submits one
		NOP OUT (not SCSI), and stops its private queue after valid completion.
		Does not unlock attach or media access. DMA direct-AXI routing follows
		the reviewed vendor topology and is tested only by actual response.
		No reset, retry, doorbell clear or free. Failure quarantines until reboot.

config A733_UFS_SCRATCH
	bool "DANGEROUS: fixed disposable Kingston Linux scratch experiment"
	default n
	depends on A733_UFS_BLOCK_RO
	help
	  Manual prepare and explicit ERASE-TEST-LINUX acknowledgement only.
	  Pins LUN0, model/capacity/GPT and one 64KiB window in partition3.
	  Two WRITE16/flush/read tests then original restore/flush/read.
	  RAM backup is LOST on reboot. Power loss/failure may destroy Linux.
	  No failure retry/reset, arbitrary LBA, block writes, format or mount.

config A733_UFS_DATA
	bool "DANGEROUS: pinned Kingston partition3 data volume"
	default n
	depends on A733_UFS_SCRATCH
	help
	  Manual data-rw=ERASE-TEST-LINUX after this boot's full scratch pass.
	  Exposes /dev/ufsdata only; /dev/ufs0 remains read-only. Reserves the
	  final 128 partition3 blocks for scratch, never includes GPT/boot/SD.
	  Every write is read-back verified and CACHE10 flushed. No reset/retry.
	  Formatting/mounting require separate explicit NSH commands, not boot.

config A733_UFS_BLOCK_RO
	bool "Experimental guarded UFS read-only block device"
	default n
	depends on A733_UFS_READCHECK
	help
	  Manual block-ro publication only after this boot's readcheck passes.
	  Uses the qualified static arena, 64KiB commands, 1MiB bounded reads.
	  No media writes, reset, retries, format, mount or cold-start support.

config A733_UFS_READCHECK
	bool "Experimental bounded UFS identity/GPT/repeated media reads"
	default n
	depends on A733_UFS_DMA_NOP
	---help---
		Explicit readcheck requires a successful NOP in this boot. Uses a
		second static guarded arena. Reads INQUIRY/CAPACITY and repeats
		16KiB head/middle/tail samples; optionally checks bounded GPT CRCs.
		Only acknowledges our previous transfer completion bit0. One initial
		completed UNIT ATTENTION may be reissued before data reads; never
		retries transport failures. No block registration, mount, reset,
		media writes or formatting. Not a cold-start power/PHY driver.

config A733_IMX214_CHECKPOINT
	bool "Experimental V1.11/J5 IMX214 read-only board checkpoint"
	default n
	depends on ARCH_CHIP_A733
	help
	  Register /dev/a733-camera for a fixed read-only CCU/PIO inventory.
	  No sensor, CSI, DPHY, ISP, DMA or PMIC access, no writes and no
	  /dev/video0. Reading it is not electrical/capture qualification.
	  The separate strict sensor-ID core has no live bus provider yet.

config A733_CAMERA_CONTROL_TEST
	bool "Experimental V1.11 camera controls, standby and MIPI packets"
	default n
	depends on A733_IMX214_CHECKPOINT && CRYPTO
	help
	  Explicit command only, requires this Image's fresh U-Boot PMIC handoff.
	  Firmware retains rails; no runtime PMIC access or voltage writes.
	  Prepare/clock tests hold reset. An explicit id-experiment command may
	  briefly release the module and read chip ID0016 at address0x10.
	  mode-experiment additionally writes one SHA256-pinned external 1080p
	  artifact and verifies standby/14 mode registers, without STREAM_ON,
	  then restores controls or quarantines until reboot. Firmware-retained
	  rails and nominal sys24M are assumptions, NOT electrical measurements
	  or strict qualification. v195 link-experiment additionally configures
	  MCSIB and briefly streams to collect packet status, then stops/restores.
	  No parser capture, DDR DMA, IOMMU, ISP or video node. Normal boot has
	  no handoff. This option never probes at boot.

config A733_HEADER_I2C
	bool "Cubie A7Z expansion-header TWI2 and TWI7"
	default y
	select I2C
	select I2C_DRIVER
	depends on ARCH_CHIP_A733
	---help---
		Register the two non-system expansion buses as /dev/i2c2 and
		/dev/i2c7.  PMIC and Type-C system TWI buses are not touched.

config A733_HEADER_SPI
	bool "Cubie A7Z expansion-header SPI1"
	default y
	select SPI
	select SPI_DRIVER
	select SPI_EXCHANGE
	depends on ARCH_CHIP_A733
	---help---
		Register the 40-pin-header SPI1 controller as /dev/spi1 using
		conservative polling PIO transfers.

config A733_FAN_PWM
	bool "Cubie A7Z fan PWM"
	default y
	select PWM
	depends on ARCH_CHIP_A733
	---help---
		Register PWM1 channel 9 on PJ27 as /dev/pwm0.  Opening the node
		does not start the fan waveform until PWMIOC_SETCHARACTERISTICS and
		PWMIOC_START are issued.

config A733_UART4
	bool "Cubie A7Z header UART4 for STM32 control"
	default y
	depends on ARCH_CHIP_A733
	---help---
		Expose the official A733 UART4 PJ24/PJ25 header mapping as
		/dev/ttyS4 at 115200 8N1, with exclusive ownership and bounded
		polling. Legacy UART TTS is retired; speech uses I2S output.

config A733_I2S0_AUDIO
	bool "Cubie A7Z I2S0 MAX98357A/INMP441/ICS43434 checkpoint"
	default y
	depends on ARCH_CHIP_A733
	---help---
		Register a passive /dev/a733-audio acceptance node. Explicit commands
		can play a tone or capture PCM using bounded polling. ICS43434 uses
		two receive slots with separate stereo/mono files. No automatic
		stream starts at boot; this is not yet a standard audio upper-half.

endif
```
