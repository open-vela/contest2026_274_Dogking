## board/a733-cubie-a7z/openvela-overlay/vendor/allwinnertech/boards/a733/cubie-a7z/configs/nsh/defconfig
```kconfig
#
# A733 / Radxa Cubie A7Z first-stage SD-card bring-up.
#

CONFIG_16550_ADDRWIDTH=64
CONFIG_16550_REGINCR=4
CONFIG_16550_REGWIDTH=32
CONFIG_16550_SUPRESS_CONFIG=y
CONFIG_16550_SUPRESS_INITIAL_CONFIG=y
CONFIG_16550_UART=y
CONFIG_16550_UART0=y
CONFIG_16550_UART0_BASE=0x02500000
CONFIG_16550_UART0_BAUD=115200
CONFIG_16550_UART0_BITS=8
CONFIG_16550_UART0_CLOCK=24000000
CONFIG_16550_UART0_IRQ=34
CONFIG_16550_UART0_SERIAL_CONSOLE=y
CONFIG_ALARM_ARCH=y
CONFIG_ARCH="arm64"
CONFIG_ARCH_ARM64=y
CONFIG_ARCH_BOARD_CUSTOM=y
CONFIG_ARCH_BOARD_CUSTOM_DIR="../vendor/allwinnertech/boards/a733/cubie-a7z"
CONFIG_ARCH_BOARD_CUSTOM_DIR_RELPATH=y
CONFIG_ARCH_BOARD_CUSTOM_NAME="cubie-a7z"
CONFIG_ARCH_CHIP_A733=y
CONFIG_A733_USB_CAMERA=y
CONFIG_ARCH_CHIP_ARM64_CUSTOM=y
CONFIG_ARCH_CHIP_CUSTOM=y
CONFIG_ARCH_CHIP_CUSTOM_DIR="../vendor/allwinnertech/chips/a733"
CONFIG_ARCH_CHIP_CUSTOM_DIR_RELPATH=y
CONFIG_ARCH_CHIP_CUSTOM_NAME="a733"
CONFIG_ARCH_CPU_UNKNOWN=y
CONFIG_ARCH_EARLY_PRINT=y
CONFIG_ARCH_INTERRUPTSTACK=4096
CONFIG_ARM64_GIC_VERSION=3
CONFIG_ARM64_GICV3_SPI_ROUTING_CPU0=y
CONFIG_ARM64_STRING_FUNCTION=y
CONFIG_BOOT_RUNFROMSDRAM=y
CONFIG_BUILTIN=y
CONFIG_CRYPTO=y
CONFIG_DEFAULT_TASK_STACKSIZE=8192
CONFIG_DEV_CONSOLE=y
CONFIG_DEV_NULL=y
CONFIG_DEV_ZERO=y
CONFIG_DEV_GPIO=y
CONFIG_EXAMPLES_GPIO=y
CONFIG_EXAMPLES_GPIO_PRIORITY=100
CONFIG_EXAMPLES_GPIO_PROGNAME="gpio"
CONFIG_EXAMPLES_GPIO_STACKSIZE=8192
CONFIG_EXAMPLES_HELLO=y
CONFIG_FS_PROCFS=y
CONFIG_FS_LARGEFILE=y
CONFIG_HAVE_CXX=y
CONFIG_CXX_STANDARD="gnu++17"
CONFIG_LIBCXX=y
CONFIG_TLS_NELEM=4
CONFIG_TLS_TASK_NELEM=4
CONFIG_SENSORS=y
CONFIG_WATCHDOG=y
CONFIG_IDLETHREAD_STACKSIZE=8192
CONFIG_INIT_ENTRYPOINT="nsh_main"
CONFIG_NSH_BUILTIN_APPS=y
CONFIG_NSH_ALTCONDEV=y
CONFIG_NSH_ALTSTDERR="/dev/a7zconsole"
CONFIG_NSH_ALTSTDIN="/dev/a7zconsole"
CONFIG_NSH_ALTSTDOUT="/dev/a7zconsole"
CONFIG_NSH_ARCHINIT=y
CONFIG_NSH_LINELEN=512
CONFIG_NSH_MAXARGUMENTS=32
CONFIG_NSH_READLINE=y
CONFIG_PREALLOC_TIMERS=4
CONFIG_PTHREAD_STACK_MIN=8192
CONFIG_RAMLOG=y
CONFIG_RAMLOG_BUFSIZE=16384
CONFIG_RAMLOG_SYSLOG=y
CONFIG_RAM_SIZE=132120576
CONFIG_RAM_START=0x40200000
CONFIG_RAM_VSTART=0x40200000
CONFIG_RAW_BINARY=y
CONFIG_READLINE_CMD_HISTORY=y
CONFIG_RR_INTERVAL=200
CONFIG_SCHED_HPWORK=y
CONFIG_SERIAL_UART_ARCH_MMIO=y
CONFIG_SERIAL_TERMIOS=y
CONFIG_TTY_SIGINT=y
CONFIG_TTY_SIGINT_CHAR=0x03
CONFIG_SIG_DEFAULT=y
CONFIG_SIG_SIGKILL_ACTION=y
CONFIG_SPINLOCK=y
CONFIG_SMP=y
CONFIG_SMP_NCPUS=8
CONFIG_SMP_DEFAULT_CPUSET=0xff
CONFIG_SYSTEM_NSH=y
CONFIG_SYSTEM_NTPC=y
CONFIG_SYSTEM_SENSORTEST=y
CONFIG_SYSTEM_SENSORTEST_PRIORITY=100
CONFIG_SYSTEM_SENSORTEST_PROGNAME="sensortest"
CONFIG_SYSTEM_SENSORTEST_STACKSIZE=8192
CONFIG_SYSTEM_SYSTEM=y
CONFIG_SYSTEM_TIME64=y
CONFIG_SYSLOG_PROCESS_NAME=y
CONFIG_SYSLOG_PROCESSID=y
CONFIG_SYSLOG_TIMESTAMP=y
CONFIG_USEC_PER_TICK=1000
CONFIG_MM_REGIONS=2
CONFIG_A733_SDMMC0=y
CONFIG_BOARD_A7Z_STORAGE=y
CONFIG_MMCSD=y
CONFIG_MMCSD_SDIO=y
CONFIG_MMCSD_MULTIBLOCK_LIMIT=16
CONFIG_SDIO_BLOCKSETUP=y
# CONFIG_MMCSD_HAVE_CARDDETECT is not set
# CONFIG_MMCSD_HAVE_WRITEPROTECT is not set
# CONFIG_MMCSD_IOCSUPPORT is not set
# CONFIG_MMCSD_MMCSUPPORT is not set
# CONFIG_MMCSD_SPI is not set
CONFIG_FS_FAT=y
CONFIG_FAT_LFN=y
CONFIG_FAT_LCNAMES=y
CONFIG_FAT_LFN_UTF8=y
CONFIG_NAME_MAX=255
CONFIG_PATH_MAX=512
CONFIG_FAT_MAXFNAME=255
CONFIG_FSUTILS_MKFATFS=y
CONFIG_GPT_PARTITION=y
CONFIG_A733_HEADER_I2C=y
CONFIG_A733_HEADER_SPI=y
CONFIG_A733_FAN_PWM=y
CONFIG_A733_WIFI_USB_CHECKPOINT=y
CONFIG_A733_NPU_CHECKPOINT=y
CONFIG_A733_TRNG=y
CONFIG_NET=y
CONFIG_NETDEV_LATEINIT=y
CONFIG_NET_ETH_PKTSIZE=1514
CONFIG_NET_BROADCAST=y
CONFIG_NET_ICMP_SOCKET=y
CONFIG_NET_TCP=y
CONFIG_NET_TCPBACKLOG=y
CONFIG_NET_TCPBACKLOG_CONNS=8
CONFIG_NET_STATISTICS=y
CONFIG_NET_UDP=y
CONFIG_IOB_NBUFFERS=128
CONFIG_NET_TCP_WRITE_BUFFERS=y
CONFIG_NET_TCP_NWRBCHAINS=16
CONFIG_NET_TCP_ALLOC_WRBCHAINS=4
CONFIG_NET_TCP_CC_NEWRENO=y
CONFIG_NET_TCP_WINDOW_SCALE=y
CONFIG_NET_TCP_WINDOW_SCALE_FACTOR=2
CONFIG_NET_TCP_SELECTIVE_ACK=y
CONFIG_NET_UDP_WRITE_BUFFERS=y
CONFIG_NET_UDP_NWRBCHAINS=16
CONFIG_NET_UDP_ALLOC_WRBCHAINS=4
CONFIG_NETINIT_IPADDR=0x00000000
CONFIG_NETINIT_DRIPADDR=0x00000000
CONFIG_NETINIT_NETMASK=0x00000000
CONFIG_NETDB_DNSCLIENT=y
CONFIG_NETUTILS_DHCPC=y
CONFIG_NETUTILS_DHCPC_HOST_NAME="cubie-a7z"
CONFIG_NETUTILS_DHCPC_RECV_TIMEOUT_MS=3000
CONFIG_NETUTILS_DHCPC_RETRIES=4
CONFIG_NETUTILS_DHCPC_BOOTP_FLAGS=0x0000
CONFIG_SYSTEM_DHCPC_RENEW=y
CONFIG_SYSTEM_PING=y
CONFIG_NETUTILS_NETCAT=y
CONFIG_NETUTILS_IPERF=y
CONFIG_NETUTILS_NTPCLIENT=y
# CONFIG_NETUTILS_NTPCLIENT_CHECK_CONNECTIVITY is not set
CONFIG_NETDB_DNSCLIENT_RECV_TIMEOUT=3
CONFIG_NETDB_DNSCLIENT_SEND_TIMEOUT=3
CONFIG_NETDB_DNSCLIENT_RETRIES=2
CONFIG_NETUTILS_NTPCLIENT_NUM_SAMPLES=3
CONFIG_NETUTILS_NTPCLIENT_RETRIES=3
CONFIG_NETUTILS_NTPCLIENT_SERVER="ntp.aliyun.com;ntp.tencent.com;cn.pool.ntp.org"
# CONFIG_NETUTILS_NTPCLIENT_STAY_ON is not set
CONFIG_NETUTILS_NTPCLIENT_TIMEOUT_MS=2000
CONFIG_NETUTILS_WEBCLIENT=y
CONFIG_NSH_WGET_BUFF_SIZE=4096
CONFIG_CRYPTO_MBEDTLS=y
CONFIG_LIB_ZLIB=y
CONFIG_LIB_CURL=y
CONFIG_EXAMPLES_AI_AGENT_VELA=y
CONFIG_EXAMPLES_AI_AGENT_VELA_SHELL_DENY=y
CONFIG_EXAMPLES_AI_AGENT_VELA_DATA_DIR="/data/ai_agent"
CONFIG_NETUTILS_CJSON=y
CONFIG_NETUTILS_MQTTC=y
# CONFIG_AI_AGENT_FEISHU is not set
# CONFIG_AI_AGENT_WEIXIN is not set
# CONFIG_AI_AGENT_MQTT is not set
# CONFIG_AI_AGENT_NODE is not set
# CONFIG_AI_AGENT_MCP is not set
CONFIG_MBEDTLS_THREADING_C=y
CONFIG_MBEDTLS_THREADING_PTHREAD=y
CONFIG_LIB_CURL_CA_PATH="/data/curl"
CONFIG_UTILS_CURL=y
CONFIG_UTILS_CURL_PROGNAME="curl"
CONFIG_UTILS_CURL_PRIORITY=100
CONFIG_UTILS_CURL_STACKSIZE=32768
CONFIG_LIB_SSH=y
CONFIG_UTILS_SSH=y
CONFIG_UTILS_SSH_PRIORITY=100
CONFIG_UTILS_SSH_STACKSIZE=32768
CONFIG_ARM64_PSCI=y
CONFIG_BOARDCTL_RESET=y
CONFIG_BOARDCTL_POWEROFF=y
CONFIG_SYSTEM_A733WIFI=y
CONFIG_SYSTEM_A733NPU=y
CONFIG_SYSTEM_AIPETLLM=y
CONFIG_AIPETLLM_LLM_FRONTEND=y
CONFIG_AIPETLLM_PROGNAME="aipetllm"
CONFIG_AIPETLLM_PRIORITY=100
CONFIG_AIPETLLM_STACKSIZE=65536
CONFIG_AIPETLLM_DEFAULT_MODEL="/data/models/qwen2.5-1.5b-instruct-q4_k_m.gguf"
CONFIG_A733WIFI_PROGNAME="wifi"
CONFIG_A733WIFI_PRIORITY=100
CONFIG_A733WIFI_STACKSIZE=8192
CONFIG_DRIVERS_WIRELESS=y
CONFIG_DRIVERS_IEEE80211=y
CONFIG_NETDEV_WIRELESS_IOCTL=y
CONFIG_WIRELESS_WAPI=y
CONFIG_WIRELESS_WAPI_CMDTOOL=y
CONFIG_WIRELESS_WAPI_PROGNAME="wapi"
CONFIG_WIRELESS_WAPI_SCAN_MAX_DATA=16384
CONFIG_I2C=y
CONFIG_I2C_DRIVER=y
CONFIG_I2C_RESET=y
CONFIG_SPI=y
CONFIG_SPI_DRIVER=y
CONFIG_SPI_EXCHANGE=y
CONFIG_SPI_CMDDATA=y
CONFIG_BOARD_A7Z_ST7735=y
CONFIG_LCD=y
CONFIG_LCD_DEV=y
CONFIG_LCD_NOGETRUN=y
CONFIG_LCD_RPORTRAIT=y
CONFIG_LCD_ST7735=y
CONFIG_LCD_ST7735_GM11=y
CONFIG_LCD_ST7735_BGR=y
CONFIG_LCD_ST7735_BPP=16
CONFIG_LCD_ST7735_SPIMODE=0
CONFIG_LCD_ST7735_FREQUENCY=12000000
# --- v121 DIAGNOSTIC ONLY: heap guard + alloc-fill to catch the
# --- display-test heap corruption at the offending write.
# --- Remove these four lines for a production image.
CONFIG_MM_NODE_GUARDSIZE=16
CONFIG_DEBUG_MM=y
CONFIG_MM_RECORD_SEQNO=y
CONFIG_MM_RECORD_PID=y
CONFIG_MM_FILL_ALLOCATIONS=y
CONFIG_MM_DUMP_ON_FAILURE=y
CONFIG_MM_DUMP_DETAILS_ON_FAILURE=y
CONFIG_GRAPHICS_LVGL=y
CONFIG_LV_USE_CLIB_MALLOC=y
CONFIG_LV_USE_CLIB_SPRINTF=y
CONFIG_LV_USE_CLIB_STRING=y
CONFIG_LV_USE_NUTTX=y
CONFIG_LV_USE_NUTTX_LCD=y
# NOTE: CONFIG_LV_NUTTX_LCD_BUFFER_SIZE only takes effect when
# LV_NUTTX_LCD_CUSTOM_BUFFER is selected; otherwise Kconfig drops it and the
# build silently uses the lv_conf_internal.h default of 60 rows.  We instead
# select the single screen-sized buffer below, which also forces
# LV_DISPLAY_RENDER_MODE_FULL and removes the partial-band path.
CONFIG_LV_NUTTX_LCD_BUFFER_COUNT=1
# CONFIG_LV_BUILD_EXAMPLES is not set
# CONFIG_LV_BUILD_DEMOS is not set
CONFIG_SYSTEM_A733DISPLAY=y
CONFIG_A733DISPLAY_PROGNAME="display"
CONFIG_A733DISPLAY_PRIORITY=100
CONFIG_A733DISPLAY_STACKSIZE=32768
CONFIG_PWM=y
CONFIG_A733_UART4=y
CONFIG_A733_I2S0_AUDIO=y
CONFIG_SYSTEM_I2CTOOL=y
CONFIG_I2CTOOL_MINBUS=2
CONFIG_I2CTOOL_MAXBUS=7
CONFIG_I2CTOOL_DEFFREQ=100000
CONFIG_SYSTEM_SPITOOL=y
CONFIG_SPITOOL_MINBUS=1
CONFIG_SPITOOL_MAXBUS=1
CONFIG_SPITOOL_DEFFREQ=1000000
CONFIG_EXAMPLES_PWM=y
CONFIG_EXAMPLES_PWM_DEVPATH="/dev/pwm0"
CONFIG_EXAMPLES_PWM_FREQUENCY=25000
CONFIG_EXAMPLES_PWM_DUTYPCT=50
CONFIG_SYSTEM_A733FTPD=y
CONFIG_SYSTEM_A733SERVICES=y
CONFIG_NETUTILS_FTPD=y
CONFIG_FTPD_WORKERSTACKSIZE=16384
CONFIG_FTPD_DATABUFFERSIZE=16384
CONFIG_FTPD_CMDBUFFERSIZE=1024
CONFIG_FTPD_MAX_SESSIONS=4
CONFIG_FTPD_IDLE_TIMEOUT=60000
CONFIG_FTPD_PASSIVE_ONLY=y
CONFIG_FTPD_KEEP_PARTIAL=y
```
